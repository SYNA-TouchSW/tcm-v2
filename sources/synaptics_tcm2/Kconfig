## sources/synaptics_tcm2/Kconfig
```kconfig
# SPDX-License-Identifier: GPL-2.0-or-later
#
# Synaptics TCM touchscreen driver configuration
#
menuconfig TOUCHSCREEN_SYNA_TCM2
	tristate "Synaptics TCM touchscreen"
	default y
	help
	  Say Y here if Synaptics TCM touchscreen is connected.
	  IF willing to compile into a kernel module, choose M here.
	  If unsure, say N.

if TOUCHSCREEN_SYNA_TCM2

choice
	default TOUCHSCREEN_SYNA_TCM2_I2C
	prompt "Synaptics TCM bus interface"
config TOUCHSCREEN_SYNA_TCM2_I2C
	bool "I2C"
	depends on I2C
config TOUCHSCREEN_SYNA_TCM2_SPI
	bool "SPI"
	depends on SPI_MASTER
endchoice

config TOUCHSCREEN_SYNA_TCM2_TOUCHCOMM_VERSION_1
	bool "Synaptics TouchComm version 1 protocol"
	depends on TOUCHSCREEN_SYNA_TCM2
	help
	  Say Y here to perform communication over TouchComm version 1 protocol

	  If unsure, say N.

config TOUCHSCREEN_SYNA_TCM2_TOUCHCOMM_VERSION_2
	bool "Synaptics TouchComm version 2 protocol"
	depends on TOUCHSCREEN_SYNA_TCM2
	help
	  Say Y here to perform communication over TouchComm version 2 protocol

	  If unsure, say N.

config TOUCHSCREEN_SYNA_TCM2_SYSFS
	bool "Synaptics TCM device attributes"
	depends on TOUCHSCREEN_SYNA_TCM2
	help
	  Say Y here to enable the sysfs interface.

	  If unsure, say N.

config TOUCHSCREEN_SYNA_TCM2_REFLASH
	bool "Synaptics TCM reflash module"
	depends on TOUCHSCREEN_SYNA_TCM2
	help
	  Say Y here to enable the feature of fw update.

	  If unsure, say N.

config TOUCHSCREEN_SYNA_TCM2_TESTING
	bool "Synaptics TCM testing module"
	depends on TOUCHSCREEN_SYNA_TCM2
	help
	  Say Y here to enable the feature of production test.

	  If unsure, say N.

config TOUCHSCREEN_SYNA_TCM2_TDDI
	bool "Synaptics TCM TDDI products"
	depends on TOUCHSCREEN_SYNA_TCM2
	help
	  Say Y here to support the TDDI products.

	  If unsure, say N.

config TOUCHSCREEN_SYNA_TCM2_DEBUG_MSG
	bool "Enable the debug logs"
	depends on TOUCHSCREEN_SYNA_TCM2
	help
	  Say Y here to enable the feature of debugging.

	  If unsure, say N.

endif
```
